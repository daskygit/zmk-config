## boards/arm/stinky/Kconfig.board
```kconfig
#
# Copyright (c) 2025 Dasky
# SPDX-License-Identifier: MIT
#

config BOARD_STINKY
	bool "stinky"
	depends on SOC_NRF52840_QIAA
```

## config/west.yml
```yaml
manifest:
  remotes:
    - name: zmkfirmware
      url-base: https://github.com/zmkfirmware
    - name: badjeff
      url-base: https://github.com/badjeff
  projects:
    - name: zmk
      remote: zmkfirmware
      revision: v0.3
      import: app/west.yml
    - name: corne-min-rgbled
      url: https://github.com/MechboardsLTD/zmk-module
      revision: corne-min-rgbled
    - name: lily58-board
      url: https://github.com/MechboardsLTD/zmk-module
      revision: lilyr2g-wireless
    - name: prospector-module
      url: https://github.com/MechboardsLTD/zmk-module
      revision: prospector
    - name: zmk-behavior-insomnia
      remote: badjeff
      revision: main
  self:
    path: config
```
